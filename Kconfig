## boards/eval-adin1110ebz/eval-adin1110ebz_defconfig
```kconfig
# Copyright (c) 2026 Analog Devices, Inc.
# SPDX-License-Identifier: BSD-3-Clause

CONFIG_PLATFORM_DRIVERS=y
CONFIG_STM32=y

CONFIG_UART_STM32=y
CONFIG_UART_STDIO_STM32=y
CONFIG_SPI_STM32=y
CONFIG_IRQ_STM32=y
CONFIG_GPIO_STM32=y
```
